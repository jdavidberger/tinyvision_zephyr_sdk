## drivers/event_logger/Kconfig
```kconfig
# Copyright (c) 2024 tinyVision.ai Inc.
# SPDX-License-Identifier: Apache-2.0

config EVENT_LOGGER
	bool "Example of custom RTL defined by the application"
	default y
	help
	  Enable driver for an application-specific FPGA peripheral.
```

## drivers/i2c/Kconfig.opencores
```kconfig
config I2C_OPENCORES_ALT
	bool "Opencores I2C driver"
	default n
	depends on DT_HAS_OPENCORES_I2C_ENABLED
	help
	  Enable support for Litex I2C driver

config I2C_OPENCORES
	bool "Opencores I2C driver"
	default y
	depends on DT_HAS_OPENCORES_I2C_ENABLED && !I2C_OPENCORES_ALT
	help
	  Enable support for Litex I2C driver
```
